## config/west.yml
```yaml
manifest:
  remotes:
    - name: zmkfirmware
      url-base: https://github.com/zmkfirmware
  projects:
    - name: zmk
      remote: zmkfirmware
      revision: main
      import: app/west.yml
  self:
    path: config
include:
  - board: nice_nano_v2                                  # <--- add these
    shield: [YOUR KEYBOARD SHIELD]_dongle snake_adapter  # <---
    artifact-name: snake_dongle                          # <---
  - board: nice_nano_v2
    shield: swoop_left
    artifact-name: swoop_left
  - board: nice_nano_v2
    shield: swoop_right
    artifact-name: swoop_right
  - board: nice_nano_v2
    shield: settings_reset
    artifact-name: settings_reset
```
